## drivers/input/touchscreen/focaltech_touch_ft3881/Kconfig
```kconfig
#
# Focaltech Touchscreen driver configuration
#

config TOUCHSCREEN_FT3881
    tristate "Focaltech Touchscreen FT3881"
    default m
    help
      Say Y here if you have Focaltech touch panel.
      If unsure, say N.
```
